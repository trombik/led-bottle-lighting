## src/main/Kconfig.projbuild
```kconfig
menu "Project configuration"

    config PROJECT_GPIO_LED
        int "GPIO number to control the LED"
        default 4 if PROJECT_LED_TYPE_SINGLE_COLOR
        help
            GPIO number of output pin to control the LED. Choose 13 when
            hardware SPI is preferred for addressable LED.

    config PROJECT_GPIO_TOUCH
        int "GPIO number of touch sensor"
        default 5
        help
            GPIO number of input pin to change PWM duty cycle

    choice PROJECT_LED_TYPE
        prompt "Type of the LED"
        default PROJECT_LED_TYPE_SINGLE_COLOR
        help
            Select one of the supported LED:
                * Single color
                * Addressable LED (SPI-based, such as APA102 and SK9822)
        config PROJECT_LED_TYPE_SINGLE_COLOR
            bool "Single color"
        config PROJECT_LED_TYPE_ADDRESSABLE_SPI
            bool "Addresssable LED (SPI)"
    endchoice

    config PROJECT_PWM_FREQ_HZ
        int "Frequency of PWM in Hz"
        depends on PROJECT_LED_TYPE_SINGLE_COLOR
        default 5000
        # XXX on ESP8266, this must be less than or equal to 50000.
        # `pwm_init()` says:
        # "Do not set the period below 20us."
        range 1000 50000
        help
            PWM frequency to control single color LED

    config PROJECT_LED_TYPE_ADDRESSABLE_SPI_N_PIXEL
        int "Number of pixel in the LED strip"
        default 8
        depends on PROJECT_LED_TYPE_ADDRESSABLE_SPI
        help
            The number of LED pixels in LED strip.

    config PROJECT_CONNECT_WIFI
        bool "Enable WiFi support"
        default y

    config PROJECT_WIFI_SSID
        string "SSID"
        default "myssid"
        depends on PROJECT_CONNECT_WIFI
        help
            WiFi SSID to connect to.

    config PROJECT_WIFI_PASSWORD
        string "Password"
        default "password"
        depends on PROJECT_CONNECT_WIFI
        help
            WiFi password

    config PROJECT_CONNECT_IPV6
        bool "Enable IPv6 support"
        depends on PROJECT_CONNECT_WIFI
        default n

    config PROJECT_SNTP_ENABLE
        bool "Enable SNTP support"
        depends on PROJECT_CONNECT_WIFI
        default y

    config PROJECT_SNTP_SERVER_NAME
        string "hostname of SNTP server"
        depends on PROJECT_SNTP_ENABLE
        default "pool.ntp.org"

    config PROJECT_SNTP_TZ
        string "string of the local timezone"
        default "UTC"
        depends on PROJECT_SNTP_ENABLE
        help
            A string of the local timezone, such as `UTC-7`.

    config PROJECT_CRON_ENABLE
        bool "Enable cron support"
        depends on PROJECT_SNTP_ENABLE
        default y
        help
            Enable cron job support
    config PROJECT_CRON_JOB_TURN_ON
        string "Time to turn on the LED"
        default "0,30 * * * * *"
        depends on PROJECT_CRON_ENABLE
        help
            Time and date string in crontab(5) format to turn on the LED.
            See https://github.com/staticlibs/ccronexpr

    config PROJECT_CRON_JOB_TURN_OFF
        string "Time to turn off the LED"
        default "15,45 * * * * *"
        depends on PROJECT_CRON_ENABLE
        help
            Time and date string in crontab(5) format to turn off the LED.
            See https://github.com/staticlibs/ccronexpr
endmenu
```
